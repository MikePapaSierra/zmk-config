## config/boards/shields/mps_status/Kconfig.defconfig
```kconfig
if SHIELD_MPS_STATUS

choice ZMK_DISPLAY_STATUS_SCREEN
    default ZMK_DISPLAY_STATUS_SCREEN_CUSTOM
endchoice

config ZMK_DISPLAY_STATUS_SCREEN_CUSTOM
    select LV_USE_LABEL

endif
```
